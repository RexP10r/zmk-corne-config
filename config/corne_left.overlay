#include <dt-bindings/zmk/keys.h>

/ {
    chosen {
        zmk,kscan = &kscan0;
    };

    wired_split {
        compatible = "zmk,wired-split";
        device = <&pro_micro_serial>;
    };
};

&pro_micro_serial {
    status = "okay";
    current-speed = <115200>;
};
